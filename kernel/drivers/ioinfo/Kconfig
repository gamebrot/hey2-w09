## kernel/drivers/ioinfo/Kconfig
```kconfig
config PROC_IO_INFO
	tristate "/proc/ioinfo support"
	default n
	help
	  get IO information, include disk io stat, io top, io wait.
config HONOR_HOTFILE_DETECT
	bool "detect and protect hot files"
	depends on TRACING && MEMCG_PROTECT_LRU
	default n
	help
	  detect and protect hot files for system and top application
config HONOR_HOTFILE_DETECT_DEBUG
	bool "detect and protect hot files"
	depends on HONOR_HOTFILE_DETECT
	default n
	help
	  debug information for hot files detect
```

## kernel/drivers/micro_dump/Kconfig
```kconfig
config HN_MICRODUMP
	tristate "micro dump."
	depends on !KASAN
	default n

config HN_MICRODUMP_GKI
	bool "micro dump for gki"
	depends on HN_MICRODUMP
	default n

config HN_MICRODUMP_DEFAULT_ENABLE
	bool "microdump default enable."
	default n

source "drivers/micro_dump/test/Kconfig"
```

## kernel/drivers/mmc/Kconfig
```kconfig
# SPDX-License-Identifier: GPL-2.0-only
#
# MMC subsystem configuration
#

menuconfig MMC
	tristate "MMC/SD/SDIO card support"
	depends on HAS_IOMEM
	help
	  This selects MultiMediaCard, Secure Digital and Secure
	  Digital I/O support.

	  If you want MMC/SD/SDIO support, you should say Y here and
	  also to your specific host controller driver.

if MMC

config HONOR_EMMC_VENDOR_MODE
	bool "mmc driver fetures support of HONOR"
	depends on MMC != n
	default y
	help
	  This selects the mmc driver fetures support of HONOR

config HONOR_SDCARD_DSM
	bool "Listen sdcard kernel err"
	depends on HONOR_EMMC_VENDOR_MODE != n
	default n
	help
	  use honor sdcard log radar

source "drivers/mmc/core/Kconfig"

source "drivers/mmc/host/Kconfig"

endif # MMC
```

## kernel/kernel/Kconfig.thermal
```kconfig
# SPDX-License-Identifier: GPL-2.0-only
config HONOR_THERMAL
	bool "Honor thermal Part"
	default n
	help
	  Control Honor thermal to insert code in kernel
```

## kernel/mm/hugepage/Kconfig
```kconfig
# SPDX-License-Identifier: GPL-2.0

# Selected when system need hugepage
config HUGEPAGE_POOL
	bool "hugepage pool management"
	default n
	depends on TRANSPARENT_HUGEPAGE
	help
	  Enable this to provide 2MB hugepage pool
	  allocation requests efficiently.

config HUGEPAGE_POOL_DEBUG
	bool "hugepage pool debug"
	default n
	depends on HUGEPAGE_POOL
	help
	  Show hugepage pool debug logs in kernel log.

config HUGEPAGE_DMA_BUF
	bool "hugepage for DMA-buf"
	default n
	depends on HUGEPAGE_POOL && DMA_SHARED_BUFFER
	help
	  Enable this to provide 2MB hugepage to THP DMA_buf

config HUGEPAGE_DMA_BUF_DEBUG
	bool "hugepage for DMA-buf debug"
	default n
	depends on HUGEPAGE_DMA_BUF
	help
	  Enable this to provide 2MB hugepage to THP DMA_buf debug

config HUGEPAGE_VMALLOC
	bool "hugepage for vmalloc"
	default n
	depends on HAVE_ARCH_HUGE_VMALLOC && HUGEPAGE_POOL
	help
	  Enable this to provide 2MB hugepage to THP vmalloc

config HUGEPAGE_VMALLOC_DEBUG
	bool "hugepage for vmalloc debug"
	default n
	depends on HUGEPAGE_VMALLOC
	help
	  Enable this to provide 2MB hugepage to THP vmalloc debug
```

## kernel/mm/mem_stats/Kconfig
```kconfig
config MEM_STATS
	bool "Enable mem stats"
	default n

config MEM_REPORT
	bool "Enable mem report"
	depends on MEM_STATS
	default n

config CMA_REPORT
	bool "CMA alloc timeout or fail report event"
	depends on MEM_REPORT
	default n

config DMA_BUF_REPORT
	bool "DMA-BUF alloc timeout or fail report event"
	depends on MEM_REPORT
	default n

config GPU_MEM_REPORT
	bool "GPU alloc timeout or fail report event"
	depends on MEM_REPORT
	default n

config KMALLOC_REPORT
	bool "KMALLOC alloc fail report event"
	depends on MEM_REPORT
	default n

config BUDDY_INFO_REPORT
	bool "Enable buddy info event report"
	depends on MEM_REPORT
	default n

config MEM_DETECT
	bool "if free page、file page、anon page anomal, event report"
	depends on MEM_STATS
	default n

config ISOLATED_DETECT
	bool "if isolated anomal, event report"
	depends on MEM_DETECT
	default n

config PAGE_FAULT_STATS
	bool "alloc pages statistics when page fault"
	depends on HONOR_ALLOC_STATS
	default n

config ANON_PAGE_STAT
	bool "alloc anonymous pages statistics when page fault"
	depends on PAGE_FAULT_STATS
	default n

config FILE_PAGE_STAT
	bool "alloc file pages statistics when page fault"
	depends on PAGE_FAULT_STATS
	default n

config SWAP_PAGE_STAT
	bool "alloc swap pages statistics when page fault"
	depends on PAGE_FAULT_STATS
	default n

config MEM_CGROUP_ALLOC_STAT
	bool "alloc pages statistics for mem cgroup"
	depends on HONOR_ALLOC_STATS
	default n
```

## kernel/mm/scm/Kconfig
```kconfig
# SPDX-License-Identifier: GPL-2.0

# Selected when system need scm
config HONOR_SCM
	tristate "Smart Cache Manager support"
	default n
	help
	  Manage memory cache smarter with appropriate strategy.

config HONOR_SCM_BUILDIN
	bool "smart cache manager support"
	default n
	help
	  Say Y here if you want to use the scm.
	  If unsure, say N here.

config HONOR_SCM_DEBUG
	bool "smart cache manager debug"
	default n
	help
	  Say Y here if you want to use the scm debug.
	  If unsure, say N here.
```
